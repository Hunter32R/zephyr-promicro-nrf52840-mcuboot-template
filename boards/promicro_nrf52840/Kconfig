## boards/promicro_nrf52840/Kconfig
```kconfig
# promicro_nrf52840 board configuration (copied from nrf52840dk and adapted)

if BOARD_PROMICRO_NRF52840

config BOARD_ENABLE_DCDC
	bool "DCDC mode"
	select SOC_DCDC_NRF52X
	default y

config BOARD_ENABLE_DCDC_HV
	bool "High Voltage DCDC converter"
	select SOC_DCDC_NRF52X_HV
	default y
	depends on SOC_NRF52840_QIAA

endif # BOARD_PROMICRO_NRF52840
```

## boards/promicro_nrf52840/board.yml
```yaml
board:
  name: promicro_nrf52840
  vendor: massdriver
  socs:
  - name: nrf52840
```
